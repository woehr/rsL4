## sel4-build-files/Kconfig
```kconfig
#
# Copyright 2014, NICTA
#
# This software may be distributed and modified according to the terms of
# the BSD 2-Clause license. Note that NO WARRANTY is provided.
# See "LICENSE_BSD2.txt" for details.
#
# @TAG(NICTA_BSD)
#

# This file defines the Kconfig menu structure.

# Modified Nov. 24, 2014 by Jordan Woehr

mainmenu "Project Configuration"

config COMMON_PATH
    string
    option env="COMMON_PATH"

menu "seL4 Kernel"
    source "kernel/Kconfig"
endmenu

menu "seL4 Libraries"
#    source "libs/libsel4/Kconfig"
    source "libs/libmuslc/Kconfig"
#    source "libs/libsel4muslcsys/Kconfig"
    source "libs/libcpio/Kconfig"
#    source "libs/libelf/Kconfig"
endmenu

menu "Tools"
    source "tools/elfloader/Kconfig"
endmenu

source "$COMMON_PATH/Kconfig"
```

## sel4-build-files/configs/bbb_defconfig
```kconfig
#
# seL4 Kernel
#
# CONFIG_ARCH_ARM_V6 is not set
CONFIG_ARCH_ARM_V7A=y

#
# seL4 System
#
# CONFIG_ARCH_I386 is not set
# CONFIG_ARCH_X86_64 is not set
CONFIG_ARCH_ARM=y
# CONFIG_ARM1136JF_S is not set
CONFIG_ARM_CORTEX_A8=y
# CONFIG_ARM_CORTEX_A9 is not set
# CONFIG_ARM_CORTEX_A15 is not set
# CONFIG_PLAT_EXYNOS54XX is not set
# CONFIG_PLAT_OMAP3 is not set
CONFIG_PLAT_AM335X=y

#
# seL4 System Parameters
#
CONFIG_ROOT_CNODE_SIZE_BITS=16
CONFIG_TIMER_TICK_MS=10
CONFIG_TIME_SLICE=1
CONFIG_RETYPE_FAN_OUT_LIMIT=256
CONFIG_MAX_NUM_WORK_UNITS_PER_PREEMPTION=100
CONFIG_MAX_NUM_BOOTINFO_DEVICE_REGIONS=199
CONFIG_MAX_NUM_BOOTINFO_UNTYPED_CAPS=167
CONFIG_FASTPATH=y
CONFIG_NUM_DOMAINS=1
CONFIG_DOMAIN_SCHEDULE=""
CONFIG_NUM_PRIORITIES=256
# CONFIG_BENCHMARK is not set

#
# Build Options
#
CONFIG_DEBUG_BUILD=y
CONFIG_IRQ_REPORTING=y
# CONFIG_OPTIMISATION_Os is not set
# CONFIG_OPTIMISATION_O0 is not set
# CONFIG_OPTIMISATION_O1 is not set
CONFIG_OPTIMISATION_O2=y
# CONFIG_OPTIMISATION_O3 is not set
# CONFIG_DANGEROUS_CODE_INJECTION is not set
# CONFIG_DEBUG_DISABLE_L2_CACHE is not set
# CONFIG_DEBUG_DISABLE_BRANCH_PREDICTION is not set

#
# Errata
#
# CONFIG_ARM_ERRATA_430973 is not set

#
# seL4 Applications
#

#
# seL4 Libraries
#
#CONFIG_LIB_SEL4=y
# CONFIG_LIB_SEL4_STUBS_USE_IPC_BUFFER_ONLY is not set
CONFIG_LIB_MUSL_C=y
CONFIG_HAVE_LIBC=y
CONFIG_HAVE_CRT=y
# CONFIG_LIB_SEL4_VKA is not set
CONFIG_LIB_CPIO=y
# CONFIG_LIB_ELF is not set
# CONFIG_LIB_SEL4_TEST is not set
# CONFIG_LIB_UTILS is not set
# CONFIG_LIB_UTILS_NO_STATIC_ASSERT is not set

#
# Tools
#
CONFIG_LIB_ELFLOADER=y
# CONFIG_ARM_ERRATA_764369=y

#
# Toolchain Options
#
CONFIG_CROSS_COMPILER_PREFIX="arm-none-eabi-"
CONFIG_KERNEL_COMPILER=""
CONFIG_KERNEL_CFLAGS=""
CONFIG_KERNEL_EXTRA_CPPFLAGS=""
# CONFIG_USER_DEBUG_INFO is not set
CONFIG_USER_EXTRA_CFLAGS=""
CONFIG_USER_CFLAGS=""
# CONFIG_BUILDSYS_USE_CCACHE is not set
# CONFIG_BUILDSYS_USE_GOANNA is not set
# CONFIG_USER_OPTIMISATION_Os is not set
# CONFIG_USER_OPTIMISATION_O0 is not set
# CONFIG_USER_OPTIMISATION_O1 is not set
CONFIG_USER_OPTIMISATION_O2=y
# CONFIG_USER_OPTIMISATION_O3 is not set
# CONFIG_LINK_TIME_OPTIMISATIONS is not set
# CONFIG_WHOLE_PROGRAM_OPTIMISATIONS_USER is not set
# CONFIG_WHOLE_PROGRAM_OPTIMISATIONS_KERNEL is not set
CONFIG_USER_DEBUG_BUILD=y
# CONFIG_BUILDSYS_CPP_SEPARATE is not set
```
